## mcu/manifest/west.yml
```yaml
# Havoc west manifest.
#
# Defines the Zephyr workspace pulled into ./mcu/ on `west update`.
# The Zephyr revision here MUST match the `zephyr.url` pin in flake.nix
# so the SDK and the source tree agree.
#
# Topology: T2 (manifest lives inside the workspace, at mcu/manifest/).
# Workspace topdir is mcu/. After `west init -l manifest/ && west update`
# you will see mcu/zephyr/, mcu/modules/, etc. populated.

manifest:
  remotes:
    - name: upstream
      url-base: https://github.com/zephyrproject-rtos
    - name: microros
      url-base: https://github.com/micro-ROS
    - name: havoc-fork
      url-base: https://github.com/sdelcore

  projects:
    - name: zephyr
      remote: upstream
      revision: v4.1.0
      # name-allowlist keeps the workspace small. Add modules here as new
      # milestones need them. The build will fail loudly if something we
      # actually depend on is missing - that's the cue to add it.
      import:
        name-allowlist:
          - cmsis           # ARM CMSIS, generally referenced by Zephyr's core
          - cmsis_6         # newer CMSIS, referenced by some Zephyr subsystems
          - hal_atmel       # SAM E70 - phase 3 of the Zephyr plan
          - picolibc        # default Zephyr libc
          - mbedtls         # transport-layer crypto, micro-ROS dep
          - segger          # RTT logging - useful on real hardware

    # micro-ROS client + transports. The repo bundles a sample app at its
    # root - we only want the modules/libmicroros subdir, wired up via
    # ZEPHYR_EXTRA_MODULES in app/CMakeLists.txt.
    #
    # Pointed at sdelcore/micro_ros_zephyr_module@fix-native-sim, a fork
    # carrying patches that let native_sim link: (1) skip CMAKE_SYSROOT
    # override on host gcc and (2) clone rcutils from sdelcore/rcutils,
    # which itself carries a time_unix.c patch for the same target. Will
    # revert to upstream jazzy if/when those PRs land upstream (issue #158).
    - name: micro_ros_zephyr_module
      remote: havoc-fork
      revision: fix-native-sim
      path: modules/micro_ros_zephyr_module

  self:
    path: manifest
```
